## boards/shields/sofle_supermini/Kconfig.defconfig
```kconfig
if SHIELD_SOFLE_SUPERMINI_LEFT || SHIELD_SOFLE_SUPERMINI_RIGHT

config ZMK_KEYBOARD_NAME
    default "Sofle SuperMini"

config ZMK_SPLIT
    default y

endif

if SHIELD_SOFLE_SUPERMINI_LEFT

config ZMK_SPLIT_ROLE_CENTRAL
    default y

endif
```

## boards/shields/sofle_supermini/Kconfig.shield
```kconfig
config SHIELD_SOFLE_SUPERMINI_LEFT
    def_bool $(shields_list_contains,sofle_supermini_left)

config SHIELD_SOFLE_SUPERMINI_RIGHT
    def_bool $(shields_list_contains,sofle_supermini_right)
```

## config/boards/shields/sofle_supermini/Kconfig.defconfig
```kconfig
if SHIELD_SOFLE_SUPERMINI_LEFT || SHIELD_SOFLE_SUPERMINI_RIGHT

config ZMK_KEYBOARD_NAME
    default "Sofle SuperMini"

config ZMK_SPLIT
    default y

endif

if SHIELD_SOFLE_SUPERMINI_LEFT

config ZMK_SPLIT_ROLE_CENTRAL
    default y

# I2C and SSD1306 are only needed on the left half (the half with the OLED).
# Enabling these on the right half causes the nRF52840 TWIM controller to
# hang at boot when it probes 0x3c and receives no ACK.
if ZMK_DISPLAY

config I2C
    default y

config SSD1306
    default y

endif # ZMK_DISPLAY

endif # SHIELD_SOFLE_SUPERMINI_LEFT
```
